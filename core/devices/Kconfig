## core/devices/Kconfig
```kconfig
menu "Devices"

config DEV_PC_VGA
       bool "Enable VGA support"
       depends on PC_BOARD
       default y

config DEV_PC_UART
       bool "Enable UART support"
       depends on PC_BOARD
       default y
       
config DEV_WB_GPIO
       bool "Enable Winbond GPIO support"
       depends on PC_BOARD
       default n 

config DEV_MEMBLOCK
       def_bool y

endmenu
```

## core/kernel/Kconfig
```kconfig
config NO_GCC_OPT
       bool
       default n

config ID_STRING_LENGTH
       int "Max. identifier length (B)"
       default "16"
       
config DEBUG
	   bool "Debug support"
	   default y

menu "Hypervisor parameters"

config EARLY_KOUTPUT
       bool "Enable early XM output"
       default y

config SPARE_SCHEDULING
       bool "Enable spare time dynamic scheduling"
       default n

menu "Partition parameters"

config KSTACK_KB
       int "Kernel stack size (KB)"
       default "8"

endmenu

endmenu

source "Kconfig.ver"

if MMU
source "kernel/mmu/Kconfig"
endif

source "klibc/Kconfig"
source "devices/Kconfig"
source "objects/Kconfig"
```

## core/kernel/ia32/Kconfig
```kconfig
mainmenu "XM Configuration"

config IA32
       def_bool y

config TSC
       def_bool y
       
config MMU
	def_bool y

config NO_HWIRQS
       int
       default "16"

config TARGET_LITTLE_ENDIAN
       def_bool y

menu "Processor"

choice
     prompt "Board"
     default PC_BOARD

config PC_BOARD
       bool "PC"

endchoice

menu "Physical memory layout"
config XM_LOAD_ADDR
        hex
        default "0x0100000"

config XM_OFFSET
       hex
       default "0xFC000000"
endmenu

config NO_CPUS
       int
       default "1"

endmenu

menu "Hypervisor arch-dependent parameters"
    
config PARTITION_NO_GDT_ENTRIES
       int "Number of GDTs entries per partition"
       default "32"
    
config IDLE_C_STATE
       int "Idle loop C-State (0-5)"
       default "1"
       
choice
       prompt "System Timer"
       default PIT

config PIT
       bool "PIT"
       
config HPET
       bool "HPET"
       
endchoice

config HPET_VENDOR_ID
       hex "HPET Vendor ID"
       default "0x8086"
       depends on HPET

endmenu

source "kernel/Kconfig"
```

## core/objects/Kconfig
```kconfig
menu "Objects"

config OBJ_STATUS_ACC
       bool "Enable XM/partition status accounting"
       default "n"

config OBJ_HM_VERBOSE
       bool "Verbose HM events"
       default y
       depends on DEBUG
       
config CONSOLE_SCAPE_SYMB
       bool "Enable partition id symbol on console write"
       default n
       
endmenu
```

## user/bootloaders/rsw/Kconfig
```kconfig
config STACK_SIZE
       int "Stack size (KB)"
       default 8

config XEF_SUPPORT
       bool "XEF support"
       default y

source "../../../core/Kconfig.ver"
```

## user/bootloaders/rsw/ia32/Kconfig
```kconfig
mainmenu "RSW Configuration"

source "Kconfig"

menu "RSW memory layout"

config LOAD_ADDR
       hex "Load address"
       default "0x1000000"

config CONTAINER_ADDR
        hex "Container Load Address"
        default "0x1002000"

endmenu

config OUTPUT_ENABLED
       bool "Enable RSW output"
       default n
```

## user/xal/common/Kconfig
```kconfig
source "../../core/Kconfig.ver"

config DEBUG
       bool "Debug"
       default n

menu "Kernel options"
config STACK_KB
       int "Stack size (KB)"
       default "8"
endmenu
```
